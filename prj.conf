## CMakeLists.txt
```
cmake_minimum_required(VERSION 3.20.0)

find_package(Zephyr REQUIRED HINTS $ENV{ZEPHYR_BASE})
project(NONE)

target_sources(app PRIVATE src/main.c)
target_sources(app PRIVATE src/data.c)
target_sources(app PRIVATE src/dummy.c)
target_sources(app PRIVATE src/lte.c)
target_sources(app PRIVATE src/gnss.c)
target_sources(app PRIVATE src/rest.c)
```

## Kconfig
```
################################################################################
# Zephyr OS

source "Kconfig.zephyr"

################################################################################
# Main module

menu "Main module"

########################################
# Application type

choice MAIN_DATA_TYPE_CHOICE
    prompt "Upload data type"
    default MAIN_DATA_TYPE_DUMMY
    help
        Data type to upload. This option specifies the type of data frames to
        upload. The data frames may be one of three types - dummy, LTE, or GNSS.
        The dummy logging application regularly uploads dummy data to the
        database server. The LTE logging application uploads LTE network-related
        data such as cell information, power saving parameters, etc. The GNSS
        logging application uploads GNSS fixes.

config MAIN_DATA_TYPE_DUMMY
    bool "Dummy"
    help
        Upload dummy data frames.

config MAIN_DATA_TYPE_LTE
    bool "LTE"
    help
        Upload LTE data frames.

config MAIN_DATA_TYPE_GNSS
    bool "GNSS"
    help
        Upload GNSS data frames.

endchoice

########################################
# Sleep timers

config MAIN_SLEEP_TIME
    int "Sleep time"
    default 300
    help
        Sleep time in seconds. This option specifies the time spent by the
        system in sleep mode in a single cycle.

########################################
# Memory allocation

config MAIN_DUMMY_BUF_SIZE
    int "Dummy data buffer size"
    default 512
    help
        Buffer size for dummy data frames. This option specifies the allocated
        buffer size to store a single dummy data point as a JSON string.

config MAIN_LTE_BUF_SIZE
    int "LTE data buffer size"
    default 512
    help
        Buffer size for LTE data frames. This option specifies the allocated
        buffer size to store a single LTE data point as a JSON string.

config MAIN_GNSS_BUF_SIZE
    int "GNSS data buffer size"
    default 512
    help
        Buffer size for GNSS data frames. This option specifies the allocated
        buffer size to store a single GNSS data point as a JSON string.

########################################
# Data upload

config MAIN_DUMMY_UPLOAD_URL
    string "Dummy data upload URL"
    default ""
    help
        URL for dummy data upload. This option specifies the URL on the database
        server, to which dummy data points are to be uploaded. The URL must not
        contain the server host name, only the resource identifier.

config MAIN_LTE_UPLOAD_URL
    string "LTE data upload URL"
    default ""
    help
        URL for LTE data upload. This option specifies the URL on the database
        server, to which LTE data points are to be uploaded. The URL must not
        contain the server host name, only the resource identifier.

config MAIN_GNSS_UPLOAD_URL
    string "GNSS data upload URL"
    default ""
    help
        URL for GNSS data upload. This option specifies the URL on the database
        server, to which GNSS data points are to be uploaded. The URL must not
        contain the server host name, only the resource identifier.

########################################
# Logging

choice MAIN_LOG_LEVEL_CHOICE
    prompt "Log level"
    depends on LOG
    default MAIN_LOG_LEVEL_INF
    help
        Message severity threshold for logging. This option controls which
        severities of messages are displayed and which ones are suppressed.
        Messages can have 4 severity levels - debug, info, warning, and error -
        in that order of increasing severity. Messages below the configured
        severity threshold are suppressed.

config MAIN_LOG_LEVEL_OFF
    bool "Off"
    help
        Do not log messages. No messages are displayed. Messages of all severity
        levels are suppressed.

config MAIN_LOG_LEVEL_ERR
    bool "Error"
    help
        Log up to error messages. Error messages are displayed. Warning, info,
        and debug messages are suppressed.

config MAIN_LOG_LEVEL_WRN
    bool "Warning"
    help
        Log up to warning messages. Error and warning messages are displayed.
        Info and debug messages are suppressed.

config MAIN_LOG_LEVEL_INF
    bool "Info"
    help
        Log up to info messages. Error, warning, and info messages are
        displayed. Debug messages are suppressed.

config MAIN_LOG_LEVEL_DBG
    bool "Debug"
    help
        Log up to debug messages. Messages of all severity levels are displayed.
        No messages are suppressed.

endchoice

config MAIN_LOG_LEVEL
    int
    depends on LOG
    default 0 if MAIN_LOG_LEVEL_OFF
    default 1 if MAIN_LOG_LEVEL_ERR
    default 2 if MAIN_LOG_LEVEL_WRN
    default 3 if MAIN_LOG_LEVEL_INF
    default 4 if MAIN_LOG_LEVEL_DBG

endmenu

################################################################################
# Data module

menu "Data module"

########################################
# Logging

choice DATA_LOG_LEVEL_CHOICE
    prompt "Log level"
    depends on LOG
    default DATA_LOG_LEVEL_INF
    help
        Message severity threshold for logging. This option controls which
        severities of messages are displayed and which ones are suppressed.
        Messages can have 4 severity levels - debug, info, warning, and error -
        in that order of increasing severity. Messages below the configured
        severity threshold are suppressed.

config DATA_LOG_LEVEL_OFF
    bool "Off"
    help
        Do not log messages. No messages are displayed. Messages of all severity
        levels are suppressed.

config DATA_LOG_LEVEL_ERR
    bool "Error"
    help
        Log up to error messages. Error messages are displayed. Warning, info,
        and debug messages are suppressed.

config DATA_LOG_LEVEL_WRN
    bool "Warning"
    help
        Log up to warning messages. Error and warning messages are displayed.
        Info and debug messages are suppressed.

config DATA_LOG_LEVEL_INF
    bool "Info"
    help
        Log up to info messages. Error, warning, and info messages are
        displayed. Debug messages are suppressed.

config DATA_LOG_LEVEL_DBG
    bool "Debug"
    help
        Log up to debug messages. Messages of all severity levels are displayed.
        No messages are suppressed.

endchoice

config DATA_LOG_LEVEL
    int
    depends on LOG
    default 0 if DATA_LOG_LEVEL_OFF
    default 1 if DATA_LOG_LEVEL_ERR
    default 2 if DATA_LOG_LEVEL_WRN
    default 3 if DATA_LOG_LEVEL_INF
    default 4 if DATA_LOG_LEVEL_DBG

endmenu

################################################################################
# Dummy module

menu "Dummy module"

########################################
# Logging

choice DUMMY_LOG_LEVEL_CHOICE
    prompt "Log level"
    depends on LOG
    default DUMMY_LOG_LEVEL_INF
    help
        Message severity threshold for logging. This option controls which
        severities of messages are displayed and which ones are suppressed.
        Messages can have 4 severity levels - debug, info, warning, and error -
        in that order of increasing severity. Messages below the configured
        severity threshold are suppressed.

config DUMMY_LOG_LEVEL_OFF
    bool "Off"
    help
        Do not log messages. No messages are displayed. Messages of all severity
        levels are suppressed.

config DUMMY_LOG_LEVEL_ERR
    bool "Error"
    help
        Log up to error messages. Error messages are displayed. Warning, info,
        and debug messages are suppressed.

config DUMMY_LOG_LEVEL_WRN
    bool "Warning"
    help
        Log up to warning messages. Error and warning messages are displayed.
        Info and debug messages are suppressed.

config DUMMY_LOG_LEVEL_INF
    bool "Info"
    help
        Log up to info messages. Error, warning, and info messages are
        displayed. Debug messages are suppressed.

config DUMMY_LOG_LEVEL_DBG
    bool "Debug"
    help
        Log up to debug messages. Messages of all severity levels are displayed.
        No messages are suppressed.

endchoice

config DUMMY_LOG_LEVEL
    int
    depends on LOG
    default 0 if DUMMY_LOG_LEVEL_OFF
    default 1 if DUMMY_LOG_LEVEL_ERR
    default 2 if DUMMY_LOG_LEVEL_WRN
    default 3 if DUMMY_LOG_LEVEL_INF
    default 4 if DUMMY_LOG_LEVEL_DBG

endmenu

################################################################################
# LTE module

menu "LTE module"

########################################
# Timeouts

config LTE_CONN_TIMEOUT
    int "Connection timeout"
    default 60
    help
        Connection timeout in seconds. This option specifies the timeout for
        waiting for a connection to be established.

config LTE_DATA_TIMEOUT
    int "Data update timeout"
    default 30
    help
        Data update timeout in seconds. This option specifies the timeout for
        waiting for data updates.

########################################
# Power saving features

config LTE_USE_PSM
    bool "Use PSM"
    default n
    help
        Enable the use of PSM. If this option is selected, the PSM feature will
        be requested from the LTE network.

config LTE_USE_EDRX
    bool "Use eDRX"
    default n
    help
        Enable the use of eDRX. If this option is selected, the eDRX feature
        will be requested from the LTE network.

########################################
# Logging

choice LTE_LOG_LEVEL_CHOICE
    prompt "Log level"
    depends on LOG
    default LTE_LOG_LEVEL_INF
    help
        Message severity threshold for logging. This option controls which
        severities of messages are displayed and which ones are suppressed.
        Messages can have 4 severity levels - debug, info, warning, and error -
        in that order of increasing severity. Messages below the configured
        severity threshold are suppressed.

config LTE_LOG_LEVEL_OFF
    bool "Off"
    help
        Do not log messages. No messages are displayed. Messages of all severity
        levels are suppressed.

config LTE_LOG_LEVEL_ERR
    bool "Error"
    help
        Log up to error messages. Error messages are displayed. Warning, info,
        and debug messages are suppressed.

config LTE_LOG_LEVEL_WRN
    bool "Warning"
    help
        Log up to warning messages. Error and warning messages are displayed.
        Info and debug messages are suppressed.

config LTE_LOG_LEVEL_INF
    bool "Info"
    help
        Log up to info messages. Error, warning, and info messages are
        displayed. Debug messages are suppressed.

config LTE_LOG_LEVEL_DBG
    bool "Debug"
    help
        Log up to debug messages. Messages of all severity levels are displayed.
        No messages are suppressed.

endchoice

config LTE_LOG_LEVEL
    int
    depends on LOG
    default 0 if LTE_LOG_LEVEL_OFF
    default 1 if LTE_LOG_LEVEL_ERR
    default 2 if LTE_LOG_LEVEL_WRN
    default 3 if LTE_LOG_LEVEL_INF
    default 4 if LTE_LOG_LEVEL_DBG

endmenu

################################################################################
# GNSS module

menu "GNSS module"

########################################
# Timeouts

config GNSS_DATA_TIMEOUT
    int "Data update timeout"
    default 300
    help
        Data update timeout in seconds. This option specifies the timeout for
        waiting for data updates.

########################################
# Logging

choice GNSS_LOG_LEVEL_CHOICE
    prompt "Log level"
    depends on LOG
    default GNSS_LOG_LEVEL_INF
    help
        Message severity threshold for logging. This option controls which
        severities of messages are displayed and which ones are suppressed.
        Messages can have 4 severity levels - debug, info, warning, and error -
        in that order of increasing severity. Messages below the configured
        severity threshold are suppressed.

config GNSS_LOG_LEVEL_OFF
    bool "Off"
    help
        Do not log messages. No messages are displayed. Messages of all severity
        levels are suppressed.

config GNSS_LOG_LEVEL_ERR
    bool "Error"
    help
        Log up to error messages. Error messages are displayed. Warning, info,
        and debug messages are suppressed.

config GNSS_LOG_LEVEL_WRN
    bool "Warning"
    help
        Log up to warning messages. Error and warning messages are displayed.
        Info and debug messages are suppressed.

config GNSS_LOG_LEVEL_INF
    bool "Info"
    help
        Log up to info messages. Error, warning, and info messages are
        displayed. Debug messages are suppressed.

config GNSS_LOG_LEVEL_DBG
    bool "Debug"
    help
        Log up to debug messages. Messages of all severity levels are displayed.
        No messages are suppressed.

endchoice

config GNSS_LOG_LEVEL
    int
    depends on LOG
    default 0 if GNSS_LOG_LEVEL_OFF
    default 1 if GNSS_LOG_LEVEL_ERR
    default 2 if GNSS_LOG_LEVEL_WRN
    default 3 if GNSS_LOG_LEVEL_INF
    default 4 if GNSS_LOG_LEVEL_DBG

endmenu

################################################################################
# REST module

menu "REST module"

########################################
# Timeouts

config REST_REQ_TIMEOUT
    int "Request timeout"
    default 60
    help
        Request timeout in seconds. This option specifies the timeout for HTTP
        requests to the database server.

########################################
# Memory allocation

config REST_BUF_SIZE
    int "Response buffer size"
    default 4096
    help
        Buffer size for HTTP responses. This option specifies the buffer size
        into which HTTP responses from the database server are written.

########################################
# Security

config REST_SEC_TAG
    int "Security tag"
    default 0
    help
        TLS security tag. This option specifies the TLS security tag
        corresponding to the CA certificate provisioned on the modem, that must
        be used to establish a secure connection with the database server. As
        the identity of the server isn't verified, it is not necessary to
        provide the actual certificate from the server. However, a dummy
        certificate is still required. Otherwise, the system's libraries
        automatically default to unencrypted connections.

########################################
# Server

config REST_HOST_NAME
    string "Host name"
    default ""
    help
        Database server host name. This option specifies the host name of the
        database server.

config REST_PORT_NUM
    int "Port number"
    default 443
    help
        Database server port number. This option specifies the port number of
        the database server.

########################################
# API

config REST_CONT_TYPE
    string "Content type"
    default "application/json"
    help
        Content type. This option specifies the value of the "content-type"
        header field used in HTTP requests to the database server.

config REST_API_KEY
    string "API key"
    default ""
    help
        API key. This option specifies the value of the "x-apikey" header field
        used in HTTP requests to the database server.

########################################
# Logging

choice REST_LOG_LEVEL_CHOICE
    prompt "Log level"
    depends on LOG
    default REST_LOG_LEVEL_INF
    help
        Message severity threshold for logging. This option controls which
        severities of messages are displayed and which ones are suppressed.
        Messages can have 4 severity levels - debug, info, warning, and error -
        in that order of increasing severity. Messages below the configured
        severity threshold are suppressed.

config REST_LOG_LEVEL_OFF
    bool "Off"
    help
        Do not log messages. No messages are displayed. Messages of all severity
        levels are suppressed.

config REST_LOG_LEVEL_ERR
    bool "Error"
    help
        Log up to error messages. Error messages are displayed. Warning, info,
        and debug messages are suppressed.

config REST_LOG_LEVEL_WRN
    bool "Warning"
    help
        Log up to warning messages. Error and warning messages are displayed.
        Info and debug messages are suppressed.

config REST_LOG_LEVEL_INF
    bool "Info"
    help
        Log up to info messages. Error, warning, and info messages are
        displayed. Debug messages are suppressed.

config REST_LOG_LEVEL_DBG
    bool "Debug"
    help
        Log up to debug messages. Messages of all severity levels are displayed.
        No messages are suppressed.

endchoice

config REST_LOG_LEVEL
    int
    depends on LOG
    default 0 if REST_LOG_LEVEL_OFF
    default 1 if REST_LOG_LEVEL_ERR
    default 2 if REST_LOG_LEVEL_WRN
    default 3 if REST_LOG_LEVEL_INF
    default 4 if REST_LOG_LEVEL_DBG

endmenu
```

## prj.conf
```kconfig
# Floating point unit
CONFIG_FPU=y

# Memory layout
CONFIG_HEAP_MEM_POOL_SIZE=32768
CONFIG_MAIN_STACK_SIZE=8192

# Libc
CONFIG_NEWLIB_LIBC=y
CONFIG_NEWLIB_LIBC_FLOAT_PRINTF=y

# GPIO driver
CONFIG_GPIO=y
CONFIG_GPIO_LOG_LEVEL_OFF=y

# Flash driver
CONFIG_FLASH=y
CONFIG_FLASH_LOG_LEVEL_OFF=y

# SPI driver
CONFIG_SPI=y
CONFIG_SPI_LOG_LEVEL_OFF=y

# SPI NOR flash driver
CONFIG_SPI_NOR=y

# Serial driver
CONFIG_SERIAL=y

# Power management
CONFIG_PM=y

# Standard output
CONFIG_STDOUT_CONSOLE=y

# Trusted firmware-M
CONFIG_TFM_LOG_LEVEL_SILENCE=y

# Board control
CONFIG_BOARD_ICARUS_LOG_LEVEL_OFF=y

# Logging library
CONFIG_LOG=y
CONFIG_LOG_BACKEND_FORMAT_TIMESTAMP=y
CONFIG_LOG_BACKEND_SHOW_COLOR=y

# Modem library
CONFIG_NRF_MODEM_LIB=y
CONFIG_NRF_MODEM_LIB_LOG_LEVEL_OFF=y

# LTE link control library
CONFIG_LTE_LINK_CONTROL=y
CONFIG_LTE_LINK_CONTROL_LOG_LEVEL_OFF=y
CONFIG_LTE_AUTO_INIT_AND_CONNECT=n
CONFIG_LTE_NETWORK_MODE_LTE_M_NBIOT_GPS=y
CONFIG_LTE_PSM_REQ_RPTAU="00110000"
CONFIG_LTE_PSM_REQ_RAT="01000001"
CONFIG_LTE_EDRX_REQ_VALUE_LTE_M="1001"
CONFIG_LTE_EDRX_REQ_VALUE_NBIOT="1001"

# Networking library
CONFIG_NETWORKING=y
CONFIG_NET_NATIVE=n

# Sockets library
CONFIG_NET_SOCKETS=y
CONFIG_NET_SOCKETS_LOG_LEVEL_OFF=y
CONFIG_NET_SOCKETS_OFFLOAD=y
CONFIG_NET_SOCKETS_POSIX_NAMES=y

# REST client library
CONFIG_REST_CLIENT=y
CONFIG_REST_CLIENT_LOG_LEVEL_OFF=y

# JSON library
CONFIG_JSON_LIBRARY=y

# Main module
CONFIG_MAIN_LOG_LEVEL_INF=y
CONFIG_MAIN_DATA_TYPE_DUMMY=y
CONFIG_MAIN_SLEEP_TIME=300
CONFIG_MAIN_DUMMY_BUF_SIZE=512
CONFIG_MAIN_LTE_BUF_SIZE=512
CONFIG_MAIN_GNSS_BUF_SIZE=512
CONFIG_MAIN_DUMMY_UPLOAD_URL=""
CONFIG_MAIN_LTE_UPLOAD_URL=""
CONFIG_MAIN_GNSS_UPLOAD_URL=""

# Data module
CONFIG_DATA_LOG_LEVEL_INF=y

# Dummy module
CONFIG_DUMMY_LOG_LEVEL_INF=y

# LTE module
CONFIG_LTE_LOG_LEVEL_INF=y
CONFIG_LTE_CONN_TIMEOUT=60
CONFIG_LTE_DATA_TIMEOUT=30
CONFIG_LTE_USE_PSM=n
CONFIG_LTE_USE_EDRX=n

# GNSS module
CONFIG_GNSS_LOG_LEVEL_INF=y
CONFIG_GNSS_DATA_TIMEOUT=300

# REST module
CONFIG_REST_LOG_LEVEL_INF=y
CONFIG_REST_REQ_TIMEOUT=60
CONFIG_REST_BUF_SIZE=4096
CONFIG_REST_SEC_TAG=0
CONFIG_REST_HOST_NAME=""
CONFIG_REST_PORT_NUM=443
CONFIG_REST_CONT_TYPE="application/json"
CONFIG_REST_API_KEY=""
```

## dts/console_uart0.overlay
```dts
/ {
    chosen {
        zephyr,console      = &uart0;
        zephyr,shell-uart   = &uart0;
    };
};
```

## dts/console_uart1.overlay
```dts
/ {
    chosen {
        zephyr,console      = &uart1;
        zephyr,shell-uart   = &uart1;
    };
};
```

## dts/sim_external.overlay
```dts
/ {
    sim-select {
        sim = "external";
    };
};
```

## dts/sim_internal.overlay
```dts
/ {
    sim-select {
        sim = "esim";
    };
};
```

## src/main.c
```c
/** @mainpage   nRF9160 Logger
 *
 *  @brief      Configurable logger based on the Actinius Icarus v2.
 *
 *  The *nRF9160 Logger* is a configurable logging device based on the Actinius
 *  Icarus v2 development board, which features the nRF9160 SiP. This logger can
 *  be configured to regularly upload dummy data, LTE network information, or
 *  GNSS fixes to an online database. For uploading data, the device accesses
 *  the internet over the LTE-M/NB-IoT network.
 */

#include <stdbool.h>

#include <zephyr/kernel.h>
#include <zephyr/logging/log.h>

#include "data.h"
#include "dummy.h"
#include "lte.h"
#include "gnss.h"
#include "rest.h"

// Register module for logging.
LOG_MODULE_REGISTER(main, CONFIG_MAIN_LOG_LEVEL);

void app_dummy_logger (void) {
    int status; // Return status for API calls.

    dummy_data_frame_t dummy_data_frame;            // Data frame.
    char dummy_json[CONFIG_MAIN_DUMMY_BUF_SIZE];    // JSON buffer.

    /*
     * Program loop. Each cycle begins with an interval during which the device
     * remains in sleep mode. After this, it obtains a dummy data frame and
     * encodes it in JSON format. Finally, it connects to the LTE network,
     * uploads the data frame, and then disconnects from the network. If errors
     * occur anywhere in this process, the LTE module is deactivated and the
     * cycle is restarted.
     */

    while (true) {
        /*
         * Enter sleep mode for the configured time interval.
         */

        LOG_INF("Entered sleep mode");
        k_sleep(K_SECONDS(CONFIG_MAIN_SLEEP_TIME));

        /*
         * Obtain data frame and encode it in JSON format. If an error occurs in
         * this process, restart the cycle.
         */

        LOG_INF("Obtaining dummy data");

        // Read data frame.
        dummy_read(&dummy_data_frame);

        // Encode data frame in JSON format.

        status = data_dummy_data_frame_to_json(
            &dummy_data_frame, dummy_json, sizeof(dummy_json)
        );

        if (status < 0) {
            // On error, restart cycle.
            continue;
        }

        /*
         * Connect to LTE network, upload data frame, and then disconnect from
         * network. If an error occurs anywhere in this process, deactivate LTE
         * and restart the cycle.
         */

        LOG_INF("Activating LTE system");

        // Activate LTE.
        status = lte_init();
        if (status < 0) {
            // On error, restart cycle.
            continue;
        }

        // Wait for connection to establish.
        status = lte_wait_conn_avail();
        if (status < 0) {
            // On error, deactivate LTE and restart cycle.
            lte_deinit();
            continue;
        }

        // Upload data frame.
        LOG_INF("Uploading dummy data");
        rest_post(CONFIG_MAIN_DUMMY_UPLOAD_URL, dummy_json);

        // Deactivate LTE.
        LOG_INF("Deactivating LTE system");
        lte_deinit();
    }
}

void app_lte_logger (void) {
    int status; // Return status for API calls.

    lte_data_frame_t lte_data_frame;            // Data frame.
    char lte_json[CONFIG_MAIN_LTE_BUF_SIZE];    // JSON buffer.

    /*
     * Program loop. Each cycle begins with an interval during which the device
     * remains in sleep mode. After this, it connects to the LTE network. Once
     * connected, it repeatedly waits for updates to network-related
     * information. Every time an update is received, an LTE data frame is
     * obtained, encoded in JSON format, and uploaded. If no update is received
     * before a timeout expires, the device disconnects from the network. If an
     * error occurs anywhere in this process, the LTE module is deactivated and
     * the cycle is restarted.
     */

    while (true) {
        /*
         * Enter sleep mode for the configured time interval.
         */

        LOG_INF("Entered sleep mode");
        k_sleep(K_SECONDS(CONFIG_MAIN_SLEEP_TIME));

        /*
         * Connect to LTE network. After this, repeatedly wait for data frames
         * and upload them as they are received. If a timeout expires,
         * disconnect from the network. If an error occurs anywhere in this
         * process, deactivate LTE and restart the cycle.
         */

        LOG_INF("Activating LTE system");

        // Activate LTE.
        status = lte_init();
        if (status < 0) {
            // On error, restart cycle.
            continue;
        }

        // Wait for connection to establish.
        status = lte_wait_conn_avail();
        if (status < 0) {
            // On error, deactivate LTE and restart cycle.
            lte_deinit();
            continue;
        }

        // Repeatedly obtain and upload data frames.
        while (true) {
            LOG_INF("Obtaining LTE data");

            // Wait for data frame.
            status = lte_wait_data_avail();
            if (status < 0) {
                // On timeout expiry, exit upload cycle.
                break;
            }

            // Read data frame.
            lte_read(&lte_data_frame);

            // Encode data frame in JSON format.

            status = data_lte_data_frame_to_json(
                &lte_data_frame, lte_json, sizeof(lte_json)
            );

            if (status < 0) {
                // On error, restart upload cycle.
                continue;
            }

            // Upload data frame.
            LOG_INF("Uploading LTE data");
            rest_post(CONFIG_MAIN_LTE_UPLOAD_URL, lte_json);
        }

        // Deactivate LTE.
        LOG_INF("Deactivating LTE system");
        lte_deinit();
    }
}

void app_gnss_logger (void) {
    int status; // Return status for API calls.

    gnss_data_frame_t gnss_data_frame;          // Data frame.
    char gnss_json[CONFIG_MAIN_GNSS_BUF_SIZE];  // JSON buffer.

    /*
     * Program loop. Each cycle begins with an interval during which the device
     * remains in sleep mode. After this, it starts GNSS reception and waits for
     * a fix. If a timeout expires, the GNSS module is deactivated and the cycle
     * is restarted. If a fix was achieved, a data frame is obtained and encoded
     * in JSON format. The device then deactivates the GNSS module and connects
     * to the LTE network, uploads the data frame, and then disconnects from the
     * network. If an error occurs anywhere in this process, the GNSS and LTE
     * modules are both deactivated, and the cycle is restarted.
     */

    while (true) {
        /*
         * Enter sleep mode for the configured time interval.
         */

        LOG_INF("Entered sleep mode");
        k_sleep(K_SECONDS(CONFIG_MAIN_SLEEP_TIME));

        /*
         * Start GNSS reception and wait for a data frame. If a timeout expires,
         * deactivate GNSS and restart the cycle. Otherwise, deactivate GNSS,
         * encode the data frame in JSON format and proceed. If an error occurs
         * anywhere in this process, deactivate GNSS and restart the cycle.
         */

        LOG_INF("Activating GNSS system");

        // Activate GNSS.
        status = gnss_init();
        if (status < 0) {
            // On error, restart cycle.
            continue;
        }

        LOG_INF("Obtaining GNSS data");

        // Wait for data frame.
        status = gnss_wait_data_avail();
        if (status < 0) {
            // On error, deactivate GNSS and restart cycle.
            gnss_deinit();
            continue;
        }

        // Read data frame.
        gnss_read(&gnss_data_frame);

        // Encode data frame in JSON format.

        status = data_gnss_data_frame_to_json(
            &gnss_data_frame, gnss_json, sizeof(gnss_json)
        );

        if (status < 0) {
            // On error, deactivate GNSS and restart cycle.
            gnss_deinit();
            continue;
        }

        // Deactivate GNSS.
        LOG_INF("Deactivating GNSS system");
        gnss_deinit();

        /*
         * Connect to LTE network, upload data frame, and then disconnect from
         * the network. If an error occurs anywhere in this process, deactivate
         * LTE and restart the cycle.
         */

        LOG_INF("Activating LTE system");

        // Activate LTE.
        status = lte_init();
        if (status < 0) {
            // On error, restart cycle.
            continue;
        }

        // Wait for connection to establish.
        status = lte_wait_conn_avail();
        if (status < 0) {
            // On error, deactivate LTE and restart cycle.
            lte_deinit();
            continue;
        }

        // Upload data frame.
        LOG_INF("Uploading GNSS data");
        rest_post(CONFIG_MAIN_GNSS_UPLOAD_URL, gnss_json);

        // Deactivate LTE.
        LOG_INF("Deactivating LTE system");
        lte_deinit();
    }
}

void main (void) {
    // Check configuration and start corresponding application.
    if (IS_ENABLED(CONFIG_MAIN_DATA_TYPE_DUMMY)) {
        LOG_INF("Starting dummy logging application");
        app_dummy_logger();
    } else if (IS_ENABLED(CONFIG_MAIN_DATA_TYPE_LTE)) {
        LOG_INF("Starting LTE logging application");
        app_lte_logger();
    } else if (IS_ENABLED(CONFIG_MAIN_DATA_TYPE_GNSS)) {
        LOG_INF("Starting GNSS logging application");
        app_gnss_logger();
    }
}
```

## src/data.c
```c
#include <stddef.h>

#include <zephyr/kernel.h>
#include <zephyr/logging/log.h>
#include <zephyr/sys/util.h>
#include <zephyr/data/json.h>

#include "data.h"

// Register module for logging.
LOG_MODULE_REGISTER(data, CONFIG_DATA_LOG_LEVEL);

// JSON description for dummy_data_frame_t structures.
static const struct json_obj_descr _dummy_data_frame_descr [] = {
    JSON_OBJ_DESCR_PRIM_NAMED(
        dummy_data_frame_t, "field1", field1,
        JSON_TOK_STRING
    ),
    JSON_OBJ_DESCR_PRIM_NAMED(
        dummy_data_frame_t, "field2", field2,
        JSON_TOK_STRING
    ),
    JSON_OBJ_DESCR_PRIM_NAMED(
        dummy_data_frame_t, "field3", field3,
        JSON_TOK_STRING
    ),
    JSON_OBJ_DESCR_PRIM_NAMED(
        dummy_data_frame_t, "field4", field4,
        JSON_TOK_STRING
    )
};

// JSON description for lte_data_frame_mode_t structures.
static const struct json_obj_descr _lte_data_frame_mode_descr [] = {
    JSON_OBJ_DESCR_PRIM_NAMED(
        lte_data_frame_mode_t, "valid", valid,
        JSON_TOK_TRUE
    ),
    JSON_OBJ_DESCR_PRIM_NAMED(
        lte_data_frame_mode_t, "mode", mode,
        JSON_TOK_STRING
    )
};

// JSON description for lte_data_frame_cell_t structures.
static const struct json_obj_descr _lte_data_frame_cell_descr [] = {
    JSON_OBJ_DESCR_PRIM_NAMED(
        lte_data_frame_cell_t, "valid", valid,
        JSON_TOK_TRUE
    ),
    JSON_OBJ_DESCR_PRIM_NAMED(
        lte_data_frame_cell_t, "id", id,
        JSON_TOK_NUMBER
    ),
    JSON_OBJ_DESCR_PRIM_NAMED(
        lte_data_frame_cell_t, "tac", tac,
        JSON_TOK_NUMBER
    )
};

// JSON description for lte_data_frame_psm_tau_t structures.
static const struct json_obj_descr _lte_data_frame_psm_tau_descr [] = {
    JSON_OBJ_DESCR_PRIM_NAMED(
        lte_data_frame_psm_tau_t, "days", day,
        JSON_TOK_NUMBER
    ),
    JSON_OBJ_DESCR_PRIM_NAMED(
        lte_data_frame_psm_tau_t, "hours", hour,
        JSON_TOK_NUMBER
    ),
    JSON_OBJ_DESCR_PRIM_NAMED(
        lte_data_frame_psm_tau_t, "minutes", min,
        JSON_TOK_NUMBER
    ),
    JSON_OBJ_DESCR_PRIM_NAMED(
        lte_data_frame_psm_tau_t, "seconds", sec,
        JSON_TOK_NUMBER
    )
};

// JSON description for lte_data_frame_psm_at_t structures.
static const struct json_obj_descr _lte_data_frame_psm_at_descr [] = {
    JSON_OBJ_DESCR_PRIM_NAMED(
        lte_data_frame_psm_at_t, "hours", hour,
        JSON_TOK_NUMBER
    ),
    JSON_OBJ_DESCR_PRIM_NAMED(
        lte_data_frame_psm_at_t, "minutes", min,
        JSON_TOK_NUMBER
    ),
    JSON_OBJ_DESCR_PRIM_NAMED(
        lte_data_frame_psm_at_t, "seconds", sec,
        JSON_TOK_NUMBER
    )
};

// JSON description for lte_data_frame_psm_t structures.
static const struct json_obj_descr _lte_data_frame_psm_descr [] = {
    JSON_OBJ_DESCR_PRIM_NAMED(
        lte_data_frame_psm_t, "valid", valid,
        JSON_TOK_TRUE
    ),
    JSON_OBJ_DESCR_OBJECT_NAMED(
        lte_data_frame_psm_t, "tau", tau,
        _lte_data_frame_psm_tau_descr
    ),
    JSON_OBJ_DESCR_OBJECT_NAMED(
        lte_data_frame_psm_t, "at", at,
        _lte_data_frame_psm_at_descr
    )
};

// JSON description for lte_data_frame_edrx_edrx_t structures.
static const struct json_obj_descr _lte_data_frame_edrx_edrx_descr [] = {
    JSON_OBJ_DESCR_PRIM_NAMED(
        lte_data_frame_edrx_edrx_t, "hours", hour,
        JSON_TOK_NUMBER
    ),
    JSON_OBJ_DESCR_PRIM_NAMED(
        lte_data_frame_edrx_edrx_t, "minutes", min,
        JSON_TOK_NUMBER
    ),
    JSON_OBJ_DESCR_PRIM_NAMED(
        lte_data_frame_edrx_edrx_t, "seconds", sec,
        JSON_TOK_NUMBER
    ),
    JSON_OBJ_DESCR_PRIM_NAMED(
        lte_data_frame_edrx_edrx_t, "milliseconds", msec,
        JSON_TOK_NUMBER
    )
};

// JSON description for lte_data_frame_edrx_ptw_t structures.
static const struct json_obj_descr _lte_data_frame_edrx_ptw_descr [] = {
    JSON_OBJ_DESCR_PRIM_NAMED(
        lte_data_frame_edrx_ptw_t, "seconds", sec,
        JSON_TOK_NUMBER
    ),
    JSON_OBJ_DESCR_PRIM_NAMED(
        lte_data_frame_edrx_ptw_t, "milliseconds", msec,
        JSON_TOK_NUMBER
    )
};

// JSON description for lte_data_frame_edrx_t structures.
static const struct json_obj_descr _lte_data_frame_edrx_descr [] = {
    JSON_OBJ_DESCR_PRIM_NAMED(
        lte_data_frame_edrx_t, "valid", valid,
        JSON_TOK_TRUE
    ),
    JSON_OBJ_DESCR_PRIM_NAMED(
        lte_data_frame_edrx_t, "mode", mode,
        JSON_TOK_STRING
    ),
    JSON_OBJ_DESCR_OBJECT_NAMED(
        lte_data_frame_edrx_t, "edrx", edrx,
        _lte_data_frame_edrx_edrx_descr
    ),
    JSON_OBJ_DESCR_OBJECT_NAMED(
        lte_data_frame_edrx_t, "ptw", ptw,
        _lte_data_frame_edrx_ptw_descr
    )
};

// JSON description for lte_data_frame_t structures.
static const struct json_obj_descr _lte_data_frame_descr [] = {
    JSON_OBJ_DESCR_OBJECT_NAMED(
        lte_data_frame_t, "mode", mode,
        _lte_data_frame_mode_descr
    ),
    JSON_OBJ_DESCR_OBJECT_NAMED(
        lte_data_frame_t, "cell", cell,
        _lte_data_frame_cell_descr
    ),
    JSON_OBJ_DESCR_OBJECT_NAMED(
        lte_data_frame_t, "psm", psm,
        _lte_data_frame_psm_descr
    ),
    JSON_OBJ_DESCR_OBJECT_NAMED(
        lte_data_frame_t, "edrx", edrx,
        _lte_data_frame_edrx_descr
    )
};

// JSON description for gnss_data_frame_loc_lat_t structures.
static const struct json_obj_descr _gnss_data_frame_loc_lat_descr [] = {
    JSON_OBJ_DESCR_PRIM_NAMED(
        gnss_data_frame_loc_lat_t, "direction", dir,
        JSON_TOK_STRING
    ),
    JSON_OBJ_DESCR_PRIM_NAMED(
        gnss_data_frame_loc_lat_t, "degrees", deg,
        JSON_TOK_NUMBER
    ),
    JSON_OBJ_DESCR_PRIM_NAMED(
        gnss_data_frame_loc_lat_t, "minutes", min,
        JSON_TOK_NUMBER
    ),
    JSON_OBJ_DESCR_PRIM_NAMED(
        gnss_data_frame_loc_lat_t, "seconds", sec,
        JSON_TOK_NUMBER
    ),
    JSON_OBJ_DESCR_PRIM_NAMED(
        gnss_data_frame_loc_lat_t, "milliseconds", msec,
        JSON_TOK_NUMBER
    )
};

// JSON description for gnss_data_frame_loc_lon_t structures.
static const struct json_obj_descr _gnss_data_frame_loc_lon_descr [] = {
    JSON_OBJ_DESCR_PRIM_NAMED(
        gnss_data_frame_loc_lon_t, "direction", dir,
        JSON_TOK_STRING
    ),
    JSON_OBJ_DESCR_PRIM_NAMED(
        gnss_data_frame_loc_lon_t, "degrees", deg,
        JSON_TOK_NUMBER
    ),
    JSON_OBJ_DESCR_PRIM_NAMED(
        gnss_data_frame_loc_lon_t, "minutes", min,
        JSON_TOK_NUMBER
    ),
    JSON_OBJ_DESCR_PRIM_NAMED(
        gnss_data_frame_loc_lon_t, "seconds", sec,
        JSON_TOK_NUMBER
    ),
    JSON_OBJ_DESCR_PRIM_NAMED(
        gnss_data_frame_loc_lon_t, "milliseconds", msec,
        JSON_TOK_NUMBER
    )
};

// JSON description for gnss_data_frame_loc_t structures.
static const struct json_obj_descr _gnss_data_frame_loc_descr [] = {
    JSON_OBJ_DESCR_PRIM_NAMED(
        gnss_data_frame_loc_t, "valid", valid,
        JSON_TOK_TRUE
    ),
    JSON_OBJ_DESCR_OBJECT_NAMED(
        gnss_data_frame_loc_t, "latitude", lat,
        _gnss_data_frame_loc_lat_descr
    ),
    JSON_OBJ_DESCR_OBJECT_NAMED(
        gnss_data_frame_loc_t, "longitude", lon,
        _gnss_data_frame_loc_lon_descr
    )
};

// JSON description for gnss_data_frame_date_t structures.
static const struct json_obj_descr _gnss_data_frame_date_descr [] = {
    JSON_OBJ_DESCR_PRIM_NAMED(
        gnss_data_frame_date_t, "valid", valid,
        JSON_TOK_TRUE
    ),
    JSON_OBJ_DESCR_PRIM_NAMED(
        gnss_data_frame_date_t, "year", year,
        JSON_TOK_NUMBER
    ),
    JSON_OBJ_DESCR_PRIM_NAMED(
        gnss_data_frame_date_t, "month", mon,
        JSON_TOK_NUMBER
    ),
    JSON_OBJ_DESCR_PRIM_NAMED(
        gnss_data_frame_date_t, "day", day,
        JSON_TOK_NUMBER
    )
};

// JSON description for gnss_data_frame_time_t structures.
static const struct json_obj_descr _gnss_data_frame_time_descr [] = {
    JSON_OBJ_DESCR_PRIM_NAMED(
        gnss_data_frame_time_t, "valid", valid,
        JSON_TOK_TRUE
    ),
    JSON_OBJ_DESCR_PRIM_NAMED(
        gnss_data_frame_time_t, "hour", hour,
        JSON_TOK_NUMBER
    ),
    JSON_OBJ_DESCR_PRIM_NAMED(
        gnss_data_frame_time_t, "minute", min,
        JSON_TOK_NUMBER
    ),
    JSON_OBJ_DESCR_PRIM_NAMED(
        gnss_data_frame_time_t, "second", sec,
        JSON_TOK_NUMBER
    ),
    JSON_OBJ_DESCR_PRIM_NAMED(
        gnss_data_frame_time_t, "millisecond", msec,
        JSON_TOK_NUMBER
    )
};

// JSON description for gnss_data_frame_t structures.
static const struct json_obj_descr _gnss_data_frame_descr [] = {
    JSON_OBJ_DESCR_OBJECT_NAMED(
        gnss_data_frame_t, "location", loc,
        _gnss_data_frame_loc_descr
    ),
    JSON_OBJ_DESCR_OBJECT_NAMED(
        gnss_data_frame_t, "date", date,
        _gnss_data_frame_date_descr
    ),
    JSON_OBJ_DESCR_OBJECT_NAMED(
        gnss_data_frame_t, "time", time,
        _gnss_data_frame_time_descr
    )
};

int data_dummy_data_frame_to_json (
    dummy_data_frame_t * data_frame, char * json, size_t len
) {
    int status; // Return status for API calls.

    // Initialize output buffer with zeros.
    memset(json, 0, len);

    /*
     * Encode data frame in JSON format and store it in output buffer. If an
     * error occurs in this process, exit with failure.
     */

    LOG_INF("Encoding dummy data frame into JSON format");

    // Encode data frame into buffer.

    status = json_obj_encode_buf(
        _dummy_data_frame_descr, ARRAY_SIZE(_dummy_data_frame_descr),
        data_frame, json, len
    );

    if (status < 0) {
        // On error, exit with failure.
        LOG_ERR(
            "Failed to encode dummy data frame into JSON format (%s)",
            strerror(-status)
        );
        return -1;
    }

    return 0;
}

int data_lte_data_frame_to_json (
    lte_data_frame_t * data_frame, char * json, size_t len
) {
    int status; // Return status for API calls.

    // Initialize output buffer with zeros.
    memset(json, 0, len);

    /*
     * Encode data frame in JSON format and store it in output buffer. If an
     * error occurs in this process, exit with failure.
     */

    LOG_INF("Encoding LTE data frame into JSON format");

    // Encode data frame into buffer.

    status = json_obj_encode_buf(
        _lte_data_frame_descr, ARRAY_SIZE(_lte_data_frame_descr),
        data_frame, json, len
    );

    if (status < 0) {
        // On error, exit with failure.
        LOG_ERR(
            "Failed to encode LTE data frame into JSON format (%s)",
            strerror(-status)
        );
        return -1;
    }

    return 0;
}

int data_gnss_data_frame_to_json (
    gnss_data_frame_t * data_frame, char * json, size_t len
) {
    int status; // Return status for API calls.

    // Initialize output buffer with zeros.
    memset(json, 0, len);

    /*
     * Encode data frame in JSON format and store it in output buffer. If an
     * error occurs in this process, exit with failure.
     */

    LOG_INF("Encoding GNSS data frame into JSON format");

    // Encode data frame into buffer.

    status = json_obj_encode_buf(
        _gnss_data_frame_descr, ARRAY_SIZE(_gnss_data_frame_descr),
        data_frame, json, len
    );

    if (status < 0) {
        // On error, exit with failure.
        LOG_ERR(
            "Failed to encode GNSS data frame into JSON format (%s)",
            strerror(-status)
        );
        return -1;
    }

    return 0;
}
```

## src/data.h
```c
/** @defgroup   data Data
 *
 *  @brief      Data frame processing.
 *
 *  This module defines the various data frame structures required by the
 *  application and is responsible for encoding them in JSON format. The three
 *  types of data frames used are dummy_data_frame_t, lte_data_frame_t, and
 *  gnss_data_frame_t, which can be encoded in JSON format by calling
 *  data_dummy_data_frame_to_json(), data_lte_data_frame_to_json(), and
 *  data_gnss_data_frame_to_json() respectively.
 */

#ifndef __DATA_H__
#define __DATA_H__

#include <stdbool.h>
#include <stddef.h>

/** @ingroup    data
 *
 *  @brief      Dummy data frame.
 *
 *  This data frame consists of dummy data solely for the sake of uploading. It
 *  does not, itself, contain any real useful information.
 */

typedef struct {
    const char * field1;    //!< Dummy string 1.
    const char * field2;    //!< Dummy string 2.
    const char * field3;    //!< Dummy string 3.
    const char * field4;    //!< Dummy string 4.
} dummy_data_frame_t;

/** @ingroup    data
 *
 *  @brief      LTE network mode.
 *
 *  This structure contains the currently active LTE network mode. It is
 *  embedded in the parent lte_data_frame_t structure that represents the
 *  complete LTE data frame.
 */

typedef struct {
    bool valid;         //!< Data valid.
    const char * mode;  //!< String representation of active network mode.
} lte_data_frame_mode_t;

/** @ingroup    data
 *
 *  @brief      LTE cell information.
 *
 *  This structure contains the current LTE cell parameters. It is embedded in
 *  the parent lte_data_frame_t structure that represents the complete LTE data
 *  frame.
 */

typedef struct {
    bool valid; //!< Data valid.
    int id;     //!< Cell ID.
    int tac;    //!< Tracking area code.
} lte_data_frame_cell_t;

/** @ingroup    data
 *
 *  @brief      LTE PSM periodic TAU interval.
 *
 *  This structure contains the LTE PSM periodic TAU interval. It is embedded in
 *  the parent lte_data_frame_psm_t structure that represents the complete LTE
 *  PSM configuration.
 */

typedef struct {
    int day;    //!< Days.
    int hour;   //!< Hours.
    int min;    //!< Minutes.
    int sec;    //!< Seconds.
} lte_data_frame_psm_tau_t;

/** @ingroup    data
 *
 *  @brief      LTE PSM active time interval.
 *
 *  This structure contains the LTE PSM active time interval. It is embedded in
 *  the parent lte_data_frame_psm_t structure that represents the complete LTE
 *  PSM configuration.
 */

typedef struct {
    int hour;   //!< Hours.
    int min;    //!< Minutes.
    int sec;    //!< Seconds.
} lte_data_frame_psm_at_t;

/** @ingroup    data
 *
 *  @brief      LTE PSM configuration.
 *
 *  This structure contains the current LTE PSM configuration. It is embedded in
 *  the parent lte_data_frame_t structure that represents the complete LTE data
 *  frame.
 */

typedef struct {
    bool valid;                     //!< Data valid.
    lte_data_frame_psm_tau_t tau;   //!< Periodic TAU interval.
    lte_data_frame_psm_at_t at;     //!< Active time interval.
} lte_data_frame_psm_t;

/** @ingroup    data
 *
 *  @brief      LTE eDRX time interval.
 *
 *  This structure contains the LTE eDRX time interval. It is embedded in the
 *  parent lte_data_frame_edrx_t structure that represents the complete LTE eDRX
 *  configuration.
 */

typedef struct {
    int hour;   //!< Hours.
    int min;    //!< Minutes.
    int sec;    //!< Seconds.
    int msec;   //!< Milliseconds.
} lte_data_frame_edrx_edrx_t;

/** @ingroup    data
 *
 *  @brief      LTE eDRX paging time window.
 *
 *  This structure contains the LTE eDRX paging time window. It is embedded in
 *  the parent lte_data_frame_edrx_t structure that represents the complete LTE
 *  eDRX configuration.
 */

typedef struct {
    int sec;    //!< Seconds.
    int msec;   //!< Milliseconds.
} lte_data_frame_edrx_ptw_t;

/** @ingroup    data
 *
 *  @brief      LTE eDRX configuration.
 *
 *  This structure contains the current LTE eDRX configuration. It is embedded
 *  in the parent lte_data_frame_t structure that represents the complete LTE
 *  data frame.
 */

typedef struct {
    bool valid;                         //!< Data valid.
    const char * mode;                  //!< Associated network mode.
    lte_data_frame_edrx_edrx_t edrx;    //!< Time interval.
    lte_data_frame_edrx_ptw_t ptw;      //!< Paging time window.
} lte_data_frame_edrx_t;

/** @ingroup    data
 *
 *  @brief      LTE data frame.
 *
 *  This data frame contains LTE network-related information obtained through
 *  notifications received from the modem.
 */

typedef struct {
    lte_data_frame_mode_t mode; //!< Network mode.
    lte_data_frame_cell_t cell; //!< Cell information.
    lte_data_frame_psm_t psm;   //!< PSM configuration.
    lte_data_frame_edrx_t edrx; //!< eDRX configuration.
} lte_data_frame_t;

/** @ingroup    data
 *
 *  @brief      GNSS latitude.
 *
 *  This structure contains the GNSS latitude. It is embedded in the parent
 *  gnss_data_frame_loc_t structure that represents the complete GNSS location.
 */

typedef struct {
    const char * dir;   //!< Geographic direction.
    int deg;            //!< Degrees.
    int min;            //!< Minutes.
    int sec;            //!< Seconds.
    int msec;           //!< Milliseconds.
} gnss_data_frame_loc_lat_t;

/** @ingroup    data
 *
 *  @brief      GNSS longitude.
 *
 *  This structure contains the GNSS longitude. It is embedded in the parent
 *  gnss_data_frame_loc_t structure that represents the complete GNSS location.
 */

typedef struct {
    const char * dir;   //!< Geographic direction.
    int deg;            //!< Degrees.
    int min;            //!< Minutes.
    int sec;            //!< Seconds.
    int msec;           //!< Milliseconds.
} gnss_data_frame_loc_lon_t;

/** @ingroup    data
 *
 *  @brief      GNSS location.
 *
 *  This structure contains the GNSS location. It is embedded in the parent
 *  gnss_data_frame_t structure that represents the complete GNSS data frame.
 */

typedef struct {
    bool valid;                     //!< Data valid.
    gnss_data_frame_loc_lat_t lat;  //!< Latitude.
    gnss_data_frame_loc_lon_t lon;  //!< Longitude.
} gnss_data_frame_loc_t;

/** @ingroup    data
 *
 *  @brief      GNSS date.
 *
 *  This structure contains the GNSS date. It is embedded in the parent
 *  gnss_data_frame_t structure that represents the complete GNSS data frame.
 */

typedef struct {
    bool valid; //!< Data valid.
    int year;   //!< Year.
    int mon;    //!< Month.
    int day;    //!< Day.
} gnss_data_frame_date_t;

/** @ingroup    data
 *
 *  @brief      GNSS time.
 *
 *  This structure contains the GNSS time. It is embedded in the parent
 *  gnss_data_frame_t structure that represents the complete GNSS data frame.
 */

typedef struct {
    bool valid; //!< Data valid.
    int hour;   //!< Hour.
    int min;    //!< Minute.
    int sec;    //!< Second.
    int msec;   //!< Millisecond.
} gnss_data_frame_time_t;

/** @ingroup    data
 *
 *  @brief      GNSS data frame.
 *
 *  This data frame contains information from the latest obtained GNSS fix.
 */

typedef struct {
    gnss_data_frame_loc_t loc;      //!< Location.
    gnss_data_frame_date_t date;    //!< Date.
    gnss_data_frame_time_t time;    //!< Time.
} gnss_data_frame_t;

/** @ingroup    data
 *
 *  @brief      Encode dummy data frame in JSON format.
 *
 *  Encodes the given dummy data frame structure in a JSON-format string.
 *
 *  @param      data_frame  Pointer to dummy data frame to be encoded.
 *  @param      json        Pointer to buffer into which encoded string should
 *                          be written, along with terminating null byte.
 *  @param      len         Length of buffer provided for encoded string.
 *
 *  @retval     0           Success.
 *  @retval     -1          Failure.
 */

int data_dummy_data_frame_to_json (
    dummy_data_frame_t * data_frame, char * json, size_t len
);

/** @ingroup    data
 *
 *  @brief      Encode LTE data frame in JSON format.
 *
 *  Encodes the given LTE data frame structure in a JSON-format string.
 *
 *  @param      data_frame  Pointer to LTE data frame to be encoded.
 *  @param      json        Pointer to buffer into which encoded string should
 *                          be written, along with terminating null byte.
 *  @param      len         Length of buffer provided for encoded string.
 *
 *  @retval     0           Success.
 *  @retval     -1          Failure.
 */

int data_lte_data_frame_to_json (
    lte_data_frame_t * data_frame, char * json, size_t len
);

/** @ingroup    data
 *
 *  @brief      Encode GNSS data frame in JSON format.
 *
 *  Encodes the given GNSS data frame structure in a JSON-format string.
 *
 *  @param      data_frame  Pointer to GNSS data frame to be encoded.
 *  @param      json        Pointer to buffer into which encoded string should
 *                          be written, along with terminating null byte.
 *  @param      len         Length of buffer provided for encoded string.
 *
 *  @retval     0           Success.
 *  @retval     -1          Failure.
 */

int data_gnss_data_frame_to_json (
    gnss_data_frame_t * data_frame, char * json, size_t len
);

#endif
```
